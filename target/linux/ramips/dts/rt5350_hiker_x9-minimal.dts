// SPDX-License-Identifier: GPL-2.0-or-later OR MIT

#include "rt5350_hiker_x9.dtsi"

/*
 * 仅覆写型号与兼容性字符串，其余硬件定义继承自基础 hiker_x9.dtsi。
 */
/ {
	compatible = "hiker,x9-minimal", "hiker,x9", "ralink,rt5350-soc";
	model = "Hiker X9 Minimal";
};

