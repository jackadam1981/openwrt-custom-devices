// SPDX-License-Identifier: GPL-2.0-or-later OR MIT

#include "rt5350_hiker_x9.dtsi"

/*
 * 全功能 Wi-Fi 版本，只调整型号与兼容性，复用基础硬件定义。
 */
/ {
	compatible = "hiker,x9-full", "hiker,x9", "ralink,rt5350-soc";
	model = "Hiker X9 Full";
};

