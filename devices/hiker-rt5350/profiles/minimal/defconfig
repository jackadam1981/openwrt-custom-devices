## devices/hiker-rt5350/profiles/minimal/defconfig
```kconfig
# Hiker RT5350 配置 v0.1
# 基础版：仅 LuCI 中文界面 + SSH
# 移除：WiFi, USB, P910ND, 防火墙, DHCP/DNS, 所有工具

#
# Target System
#
CONFIG_TARGET_ramips=y
CONFIG_TARGET_ramips_rt305x=y
CONFIG_TARGET_ramips_rt305x_DEVICE_hiker_hiker=y

#
# Root filesystem
#
CONFIG_TARGET_ROOTFS_SQUASHFS=y

#
# Base system (最精简)
#
CONFIG_PACKAGE_base-files=y
CONFIG_PACKAGE_busybox=y
CONFIG_PACKAGE_dropbear=y
CONFIG_PACKAGE_fstools=y
CONFIG_PACKAGE_kmod-leds-gpio=y
CONFIG_PACKAGE_libc=y
CONFIG_PACKAGE_libgcc=y
CONFIG_PACKAGE_netifd=y
CONFIG_PACKAGE_procd=y
CONFIG_PACKAGE_uci=y
CONFIG_PACKAGE_urandom-seed=y

#
# LuCI Web 界面（最小化）
#
CONFIG_PACKAGE_luci-light=y
CONFIG_PACKAGE_luci-theme-bootstrap=y
CONFIG_PACKAGE_uhttpd=y

#
# 中文语言包
#
CONFIG_LUCI_LANG_zh_Hans=y
CONFIG_PACKAGE_luci-i18n-base-zh-cn=y

#
# 移除所有额外功能
#
# CONFIG_PACKAGE_fwtool is not set
# CONFIG_PACKAGE_logd is not set
# CONFIG_PACKAGE_mtd is not set
# CONFIG_PACKAGE_opkg is not set
# CONFIG_PACKAGE_swconfig is not set
# CONFIG_PACKAGE_urngd is not set
# CONFIG_PACKAGE_dnsmasq is not set
# CONFIG_PACKAGE_firewall4 is not set
# CONFIG_PACKAGE_nftables is not set
# CONFIG_PACKAGE_iptables is not set
# CONFIG_PACKAGE_ppp is not set
# CONFIG_PACKAGE_ppp-mod-pppoe is not set
# CONFIG_PACKAGE_ip6tables is not set
# CONFIG_PACKAGE_odhcp6c is not set
# CONFIG_PACKAGE_odhcpd-ipv6only is not set
# CONFIG_PACKAGE_kmod-usb-core is not set
# CONFIG_PACKAGE_kmod-usb-ohci is not set
# CONFIG_PACKAGE_kmod-usb2 is not set
# CONFIG_PACKAGE_kmod-mac80211 is not set
# CONFIG_PACKAGE_kmod-rt2800-lib is not set
# CONFIG_PACKAGE_kmod-rt2800-mmio is not set
# CONFIG_PACKAGE_kmod-rt2800-soc is not set
# CONFIG_PACKAGE_kmod-rt2x00-lib is not set
# CONFIG_PACKAGE_kmod-rt2x00-mmio is not set
# CONFIG_PACKAGE_wpad-basic-mbedtls is not set
# CONFIG_PACKAGE_hostapd-common is not set
# CONFIG_PACKAGE_iw is not set
# CONFIG_PACKAGE_iwinfo is not set
```

## devices/hiker-rt5350/profiles/wifi-client/defconfig
```kconfig
# Hiker RT5350 配置 v0.3
# 包含：v0.2 + WiFi 客户端
# = LuCI 中文 + P910ND + WiFi 客户端
# 移除：WiFi AP, 防火墙, DHCP/DNS, 工具包

#
# Target System
#
CONFIG_TARGET_ramips=y
CONFIG_TARGET_ramips_rt305x=y
CONFIG_TARGET_ramips_rt305x_DEVICE_hiker_hiker=y

#
# Root filesystem
#
CONFIG_TARGET_ROOTFS_SQUASHFS=y

#
# Base system
#
CONFIG_PACKAGE_base-files=y
CONFIG_PACKAGE_busybox=y
CONFIG_PACKAGE_dropbear=y
CONFIG_PACKAGE_fstools=y
CONFIG_PACKAGE_fwtool=y
CONFIG_PACKAGE_kmod-leds-gpio=y
CONFIG_PACKAGE_libc=y
CONFIG_PACKAGE_libgcc=y
CONFIG_PACKAGE_logd=y
CONFIG_PACKAGE_mtd=y
CONFIG_PACKAGE_netifd=y
CONFIG_PACKAGE_opkg=y
CONFIG_PACKAGE_procd=y
CONFIG_PACKAGE_swconfig=y
CONFIG_PACKAGE_uci=y
CONFIG_PACKAGE_urandom-seed=y
CONFIG_PACKAGE_urngd=y

#
# LuCI 最小化
#
CONFIG_PACKAGE_luci-light=y
CONFIG_PACKAGE_luci-theme-bootstrap=y
CONFIG_PACKAGE_uhttpd=y

#
# 中文
#
CONFIG_LUCI_LANG_zh_Hans=y
CONFIG_PACKAGE_luci-i18n-base-zh-cn=y

#
# USB 打印机（from v0.2）
#
CONFIG_PACKAGE_kmod-usb-core=y
CONFIG_PACKAGE_kmod-usb-ohci=y
CONFIG_PACKAGE_kmod-usb2=y
CONFIG_PACKAGE_kmod-usb-printer=y

#
# P910ND 打印服务器（from v0.2）
#
CONFIG_PACKAGE_p910nd=y
CONFIG_PACKAGE_luci-app-p910nd=y
CONFIG_PACKAGE_luci-i18n-p910nd-zh-cn=y

#
# WiFi 客户端
#
CONFIG_PACKAGE_kmod-mac80211=y
CONFIG_PACKAGE_kmod-rt2800-lib=y
CONFIG_PACKAGE_kmod-rt2800-mmio=y
CONFIG_PACKAGE_kmod-rt2800-soc=y
CONFIG_PACKAGE_kmod-rt2x00-lib=y
CONFIG_PACKAGE_kmod-rt2x00-mmio=y
CONFIG_PACKAGE_wpa-supplicant-mbedtls=y
CONFIG_PACKAGE_iw=y
CONFIG_PACKAGE_iwinfo=y

#
# 移除不需要的
#
# CONFIG_PACKAGE_hostapd is not set
# CONFIG_PACKAGE_hostapd-common is not set
# CONFIG_PACKAGE_wpad-basic-mbedtls is not set
# CONFIG_PACKAGE_dnsmasq is not set
# CONFIG_PACKAGE_firewall4 is not set
# CONFIG_PACKAGE_nftables is not set
# CONFIG_PACKAGE_iptables is not set
# CONFIG_PACKAGE_ppp is not set
# CONFIG_PACKAGE_ip6tables is not set
# CONFIG_PACKAGE_odhcp6c is not set
# CONFIG_PACKAGE_odhcpd-ipv6only is not set
# CONFIG_PACKAGE_kmod-usb-core is not set
# CONFIG_PACKAGE_kmod-usb-ohci is not set
# CONFIG_PACKAGE_kmod-usb2 is not set
```
